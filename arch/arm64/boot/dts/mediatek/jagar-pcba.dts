// SPDX-License-Identifier: (GPL-2.0 OR MIT)
/*
 * Copyright (C) 2021 MediaTek Inc.
 */

#include "mediatek/jagar.dts"

&gpio_keys {
	lid {
		label = "Lid";
		gpios = <&pio 1 GPIO_ACTIVE_LOW>;
		linux,code = <SW_LID>;
		linux,input-type = <EV_SW>;
		wakeup-source; /*gpio-key,wakeup;*/
	};
};

